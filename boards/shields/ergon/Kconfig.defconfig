## boards/shields/ergon/Kconfig.defconfig
```kconfig
if SHIELD_ERGON_LEFT

# Name must be less than 16 characters long!
config ZMK_KEYBOARD_NAME
    default "ergon"

config ZMK_SPLIT_ROLE_CENTRAL
    default y

endif

if SHIELD_ERGON_LEFT || SHIELD_ERGON_RIGHT

config ZMK_SPLIT
    default y

config ZMK_DISPLAY_STATUS_SCREEN_CUSTOM_ROTATE
    bool "Rotates screens -90 for main and 90 for side"

endif
```

## boards/shields/ergon/Kconfig.shield
```kconfig
config SHIELD_ERGON_LEFT
    def_bool $(shields_list_contains,ergon_left)

config SHIELD_ERGON_RIGHT
    def_bool $(shields_list_contains,ergon_right)
```

## config/west.yml
```yaml
manifest:
  remotes:
    - name: zmkfirmware
      url-base: https://github.com/zmkfirmware
    # Additional modules containing boards/shields/custom code can be listed here as well
    # See https://docs.zephyrproject.org/3.2.0/develop/west/manifest.html#projects
    - name: zmkbodin
      url-base: https://github.com/9bodorojo
  projects:
    - name: zmk
      remote: zmkbodin
      revision: rotate-display
      import: app/west.yml
  self:
    path: config
```
